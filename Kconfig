## Kconfig
```kconfig
source "src/arch/Kconfig"
source "src/soc/Kconfig"

menu "General Options"

config BOOTLOADER_SIZE
	int "FLASH reserved for bootloader"
	default 8
	help
		This option specifies the amount of FLASH (measured in kB) reserved for
		a bootloader image.

config STACK_SIZE
	int "Size of stack"
	default 1024
	help
		TBD

endmenu

menu "Build Options"

config RAM_BUILD
	bool "Build for execution in RAM"
	default n
	help
		TBD

config RAM_LOAD_AREA_SIZE
	int "RAM reserved for image"
	depends on RAM_BUILD
	default 8
	help
		Area reserved in RAM for loading an image (measured in kB)

endmenu
```

## src/arch/Kconfig
```kconfig
# The machine architecture is selected by the SOC, which is selected by the board, which is selected by the user

config ARM
	bool
	help
		ARM architecture

# Plan to support
config SANDBOX
	bool
	help
		Sandbox architecture
```

## src/boards/samrh71_ek/samrh71_ek_defconfig
```kconfig
# CONFIG_BOARD_SAM_RH71_EK=y
# This configuration option needs to be set by the above one being set
CONFIG_SOC_SERIES_SAMRH71=y

# CONFIG_RAM_BUILD=y
```

## src/boards/samv71_xult_ek/samv71_xult_ek_defconfig
```kconfig
# CONFIG_BOARD_SAMV71_XULT_EK=y
# This configuration option needs to be set by the above one being set
CONFIG_SOC_SERIES_SAMV71=y
# CONFIG_SOC_SAMV71Q21=y
```

## src/soc/Kconfig
```kconfig
choice
	prompt "SoC/CPU/Configuration Selection"

source "src/soc/arm/*/Kconfig.soc"

endchoice

# This is where the actual hardware configuration comes from - e.g. MCU part number selection, PAGE_SIZE, etc.
menu "Hardware Configuration"
# osource "$(SOC_DIR)/$(ARCH)/Kconfig"
# osource "$(SOC_DIR)/$(ARCH)/*/Kconfig"
osource "src/soc/arm/*/Kconfig"

config PAGE_SIZE
	int "FLASH page size"
	help
		"FLASH page size in bytes"

config FLASH_BASE_ADDRESS
	hex "FLASH base address"
	help
		"xxx"

config FLASH_SIZE
	int "FLASH size in kB"
	help
		"xxx"

config SRAM_BASE_ADDRESS
	hex "SRAM base address"
	help
		"xxx"

config SRAM_SIZE
	int "SRAM size"
	help
		"SRAM size in kB"

endmenu
```

## src/soc/arm/atmel_sam/Kconfig
```kconfig
config SOC_FAMILY_SAM
	bool
	# select HAS_SEGGER_RTT

# Only show these options if SAM is the active SOC family
if SOC_FAMILY_SAM

config SOC_FAMILY
	string
	default "atmel_sam"

# Select SoC Part No. and configuration options
# Include all Kconfig files from the selected family series folders
source "src/soc/arm/atmel_sam/*/Kconfig.soc"

endif # SOC_FAMILY_SAM
```

## src/soc/arm/atmel_sam/samrh71/Kconfig.series
```kconfig
# Atmel SAM V71 MCU series

# Copyright (c) 2019 Gerson Fernando Budke
# Copyright (c) 2016 Piotr Mienkowski
# SPDX-License-Identifier: Apache-2.0

config SOC_SERIES_SAMRH71
	bool "Atmel SAMRH71 MCU"
	select ARM
	# select CPU_CORTEX_M7
	select SOC_FAMILY_SAM
	# select CPU_HAS_FPU_DOUBLE_PRECISION
	# select CPU_CORTEX_M_HAS_DWT
	# select ASF
	# select XIP
	# select CPU_HAS_ARM_MPU
	# select ARM_MPU
	# select HAS_SWO
	help
	  Enable support for Atmel SAM RH71 ARM Cortex-M7 Microcontrollers.
	  Part No.: SAMRH71..
```

## src/soc/arm/atmel_sam/samrh71/Kconfig.soc
```kconfig
if SOC_SERIES_SAMRH71

# NOTE: The help for this should be provided by a higher-level Kconfig
config PAGE_SIZE
	int
	default 256

config FLASH_BASE_ADDRESS
	default 0x10000000

config SRAM_BASE_ADDRESS
	default 0x21000000

config SRAM_SIZE
	default 768

config FLASH_SIZE
	default 128

endif # SOC_SERIES_SAMRH71
```

## src/soc/arm/atmel_sam/samv71/Kconfig.series
```kconfig
# Atmel SAM V71 MCU series

# Copyright (c) 2019 Gerson Fernando Budke
# Copyright (c) 2016 Piotr Mienkowski
# SPDX-License-Identifier: Apache-2.0

config SOC_SERIES_SAMV71
	bool "Atmel SAMV71 MCU"
	select ARM
	# select CPU_CORTEX_M7
	select SOC_FAMILY_SAM
	# select CPU_HAS_FPU_DOUBLE_PRECISION
	# select CPU_CORTEX_M_HAS_DWT
	# select ASF
	# select XIP
	# select CPU_HAS_ARM_MPU
	# select ARM_MPU
	# select HAS_SWO
	help
	  Enable support for Atmel SAM V71 ARM Cortex-M7 Microcontrollers.
	  Part No.: SAM771..
```

## src/soc/arm/atmel_sam/samv71/Kconfig.soc
```kconfig
# choice
# 	prompt "Atmel SAMV71 MCU Selection"
# 	depends on SOC_SERIES_SAMV71
# 
# config SOC_SAMV71Q21
# 	bool "SAMV71Q21"
# 
# endchoice

if SOC_SERIES_SAMV71

# NOTE: The help for this should be provided by a higher-level Kconfig
config PAGE_SIZE
	int
	default 512
	#int "FLASH page size"

config FLASH_BASE_ADDRESS
	default 0x00400000

config SRAM_BASE_ADDRESS
	default 0x20400000

config SRAM_SIZE
	default 384

# NOTE: Intentionally limiting this to match the RH71; the real value is 2048
config FLASH_SIZE
	default 128

endif # SOC_SERIES_SAMV71
```
